#include <dt-bindings/board/am335x-bbw-bbb-base.h>
#include <dt-bindings/pinctrl/am33xx.h>


&am33xx_pinmux {
	uart5_pins: pinmux_uart5_pins {
		pinctrl-single,pins = <
			BONE_P8_38 (PIN_INPUT_PULLUP | MUX_MODE4) 	   /* P8_38: lcd_data9.uart5_rxd */
			BONE_P8_37 (PIN_OUTPUT_PULLDOWN | MUX_MODE4)   /* P8_37: lcd_data8.uart5_txd */
		>;
	};
};

&uart5 {
	pinctrl-names = "default";
	pinctrl-0 = <&uart5_pins>;
	status = "okay";
};
