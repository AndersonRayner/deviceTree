#include <dt-bindings/board/am335x-bbw-bbb-base.h>
#include <dt-bindings/pinctrl/am33xx.h>

&am33xx_pinmux {
    i2c1_pins: pinmux_i2c1_pins {
            pinctrl-single,pins = <
            0x180 0x73  /* uart1_ctsn.i2c1_sda, SLEWCTRL_SLOW | INPUT_PULLUP | MODE3 */
            0x184 0x73  /* uart1_rtsn.i2c1_scl, SLEWCTRL_SLOW | INPUT_PULLUP | MODE3 */
            >;
    };
};


&i2c1 {
	status = "okay";
	pinctrl-names = "default";
	pinctrl-0 = <&i2c1_pins>;

	clock-frequency = <400000>;

};


