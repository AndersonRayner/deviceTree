#include <dt-bindings/board/am335x-bbw-bbb-base.h>
#include <dt-bindings/pinctrl/am33xx.h>


&am33xx_pinmux {
	uart4_pins: pinmux_uart4_pins {
		pinctrl-single,pins = <
			BONE_P9_11 (PIN_INPUT_PULLUP    | MUX_MODE6) /* P9_11: gpmc_wait0.uart4_rxd_mux2 */
			BONE_P9_13 (PIN_OUTPUT_PULLDOWN | MUX_MODE6) /* P9_13: gpmc_wpn.uart4_txd_mux2  */
		>;
	};
};

&uart4 {
	pinctrl-names = "default";
	pinctrl-0 = <&uart4_pins>;
	status = "okay";
};